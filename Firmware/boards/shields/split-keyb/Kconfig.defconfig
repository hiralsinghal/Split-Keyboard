## Firmware/boards/shields/split-keyb/Kconfig.defconfig
```kconfig
if SHIELD_SPLIT_KEYB_LEFT

# Name must be less than 16 characters long!
config ZMK_KEYBOARD_NAME
    default "Split Keyb"

config ZMK_SPLIT_ROLE_CENTRAL
    default y

endif

if SHIELD_SPLIT_KEYB_LEFT || SHIELD_SPLIT_KEYB_RIGHT
config ZMK_SPLIT
    default y

endif
```

## Firmware/boards/shields/split-keyb/Kconfig.shield
```kconfig
# No whitespace after the comma or in your part name!
config SHIELD_SPLIT_KEYB_LEFT
    def_bool $(shields_list_contains,split_keyb_left)

config SHIELD_SPLIT_KEYB_RIGHT
    def_bool $(shields_list_contains,split_keyb_right)
```
